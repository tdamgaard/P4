import processing.serial.*;

Serial myPort;  // Create object from Serial class
int val;     // Data received from the serial port


/*
 ╔═════════════╦══════════════════════════════════════╦══════════╗
 ║    Navn     ║                Formål                ║ Kommando ║
 ╠═════════════╬══════════════════════════════════════╬══════════╣
 ║ ERROR       ║ Fejl i coms                          ║ 0xEE     ║
 ║ OK          ║ Ping-pong OK                         ║ 0x10     ║
 ║ Instruks    ║ Sende kommando til arduino           ║ 0x11     ║
 ║ SS High     ║ Sætte SS høj                         ║ 0x12     ║
 ║ SS Low      ║ Sætte SS lav                         ║ 0x13     ║
 ║ Load data   ║ Overføre 256 byte til arduino'en     ║ 0x14     ║
 ║ Load adress ║ Giv arduino en adresse at skrive til ║ 0x15     ║
 ║ Write data  ║ Skriv data via. SPI                  ║ 0x16     ║
 ╚═════════════╩══════════════════════════════════════╩══════════╝
*/

final int ERROR_MSG       =  0xEE;
final int OK_MSG          =  0x10;
final int CMD_MSG         =  0x11;
final int SS_HIGH_MSG     =  0x12;
final int SS_LOW_MSG      =  0x13;
final int LOAD_DATA_MSG   =  0x14;
final int LOAD_ADD_MSG    =  0x15;
final int WRITE_DATA_MSG  =  0x16;
final int SAMPLE_NR_MSG   =  0x17;

final int SAMPLE_LENGTH   = 16;

final int TIMEOUT         =  20;
int arrayToWrite[] = {
  0xAA, 0xAA, 0xAA, 0xAA, 0xAA, 0xAA, 0xAA, 0xAA,
  0xAA, 0xAA, 0xAA, 0xAA, 0xAA, 0xAA, 0xAA, 0xCC
};
/*
int arrayToWrite[] = {
  0xFF, 0xFF, 0xFF, 0xFF, 0xFF, 0xFF, 0xFF, 0xFF,
  0xFF, 0xFF, 0xFF, 0xFF, 0xFF, 0xFF, 0xFF, 0xFF,
  0xFF, 0xFF, 0xFF, 0xFF, 0xFF, 0xFF, 0xFF, 0xFF,
  0xFF, 0xFF, 0xFF, 0xFF, 0xFF, 0xFF, 0xFF, 0xFF,
  0xFF, 0xFF, 0xFF, 0xFF, 0xFF, 0xFF, 0xFF, 0xFF,
  0xFF, 0xFF, 0xFF, 0xFF, 0xFF, 0xFF, 0xFF, 0xFF,
  0xFF, 0xFF, 0xFF, 0xFF, 0xFF, 0xFF, 0xFF, 0xFF,
  0xFF, 0xFF, 0xFF, 0xFF, 0xFF, 0xFF, 0xFF, 0xFF,
  0xFF, 0xFF, 0xFF, 0xFF, 0xFF, 0xFF, 0xFF, 0xFF,
  0xFF, 0xFF, 0xFF, 0xFF, 0xFF, 0xFF, 0xFF, 0xFF,
  0xFF, 0xFF, 0xFF, 0xFF, 0xFF, 0xFF, 0xFF, 0xFF,
  0xFF, 0xFF, 0xFF, 0xFF, 0xFF, 0xFF, 0xFF, 0xFF,
  0xFF, 0xFF, 0xFF, 0xFF, 0xFF, 0xFF, 0xFF, 0xFF,
  0xFF, 0xFF, 0xFF, 0xFF, 0xFF, 0xFF, 0xFF, 0xFF,
  0xFF, 0xFF, 0xFF, 0xFF, 0xFF, 0xFF, 0xFF, 0xFF,
  0xFF, 0xFF, 0xFF, 0xFF, 0xFF, 0xFF, 0xFF, 0xFF,
  0xFF, 0xFF, 0xFF, 0xFF, 0xFF, 0xFF, 0xFF, 0xFF,
  0xFF, 0xFF, 0xFF, 0xFF, 0xFF, 0xFF, 0xFF, 0xFF,
  0xFF, 0xFF, 0xFF, 0xFF, 0xFF, 0xFF, 0xFF, 0xFF,
  0xFF, 0xFF, 0xFF, 0xFF, 0xFF, 0xFF, 0xFF, 0xFF,
  0xFF, 0xFF, 0xFF, 0xFF, 0xFF, 0xFF, 0xFF, 0xFF,
  0xFF, 0xFF, 0xFF, 0xFF, 0xFF, 0xFF, 0xFF, 0xFF,
  0xFF, 0xFF, 0xFF, 0xFF, 0xFF, 0xFF, 0xFF, 0xFF,
  0xFF, 0xFF, 0xFF, 0xFF, 0xFF, 0xFF, 0xFF, 0xFF,
  0xFF, 0xFF, 0xFF, 0xFF, 0xFF, 0xFF, 0xFF, 0xFF,
  0xFF, 0xFF, 0xFF, 0xFF, 0xFF, 0xFF, 0xFF, 0xFF,
  0xFF, 0xFF, 0xFF, 0xFF, 0xFF, 0xFF, 0xFF, 0xFF,
  0xFF, 0xFF, 0xFF, 0xFF, 0xFF, 0xFF, 0xFF, 0xFF,
  0xFF, 0xFF, 0xFF, 0xFF, 0xFF, 0xFF, 0xFF, 0xFF,
  0xFF, 0xFF, 0xFF, 0xFF, 0xFF, 0xFF, 0xFF, 0xFF,
  0xFF, 0xFF, 0xFF, 0xFF, 0xFF, 0xFF, 0xFF, 0xFF,
  0xFF, 0xFF, 0xFF, 0xFF, 0xFF, 0xFF, 0xFF, 0xFF
};
*/
int[] arrayToRead = new int[SAMPLE_LENGTH];

void setup()
{
  // I know that the first port in the serial list on my mac
  // is Serial.list()[0].
  // On Windows machines, this generally opens COM1.
  // Open whatever port is the one you're using.
  for(int i = 0; i < Serial.list().length; i++){
    String portName = Serial.list()[i]; //change the 0 to a 1 or 2 etc. to match your port
    println(portName);
  }
  String portName = Serial.list()[8]; //change the 0 to a 1 or 2 etc. to match your port
  portName = "/dev/cu.usbmodem1411";
  myPort = new Serial(this, portName, 9600);
  delay(1000);
  
}



void draw()
{
  // while(!putSampleNr(1));
  putData();
  delay(50);
  
  
}

void putData(){
  myPort.write(CMD_MSG);
  myPort.write(LOAD_DATA_MSG);
  for(int i = 0; i < SAMPLE_LENGTH; i++){
    myPort.write(arrayToWrite[i]);
    delay(1);
  }
  // delay(200);
  
  // while(myPort.available() == 0){};
  
  
  for(int i = 0; i < SAMPLE_LENGTH; i++){
    // while(myPort.available() == 0);
    
    arrayToRead[i] = myPort.read();
    // println("i:\t", i, ":\t", arrayToRead[i]);
    // delay(1);
  }
}

boolean putSampleNr(int sampleNr){
  myPort.write(CMD_MSG);
  delay(1);
  myPort.read();
  myPort.write(SAMPLE_NR_MSG);
  delay(1);
  myPort.write(sampleNr);
  delay(1);
  if(myPort.read() == sampleNr){
    return true;
  } else {
    return false;
  }
  
  
}


/*
boolean putSampleNr(int sampleNr){
  // delay(50);
  println("put sample");
  myPort.write(CMD_MSG);  
  delay(2);
  waitForSerial();
  
  int tempStorage = myPort.read(); // Modtager sample nr
  println(hex(tempStorage, 2));
  
  if(tempStorage != OK_MSG){
    println("Error start");
    return false;
  }
  myPort.write(SAMPLE_NR_MSG);
  myPort.write(CMD_MSG);
  myPort.write(sampleNr);
  delay(4);
  
  waitForSerial();

  tempStorage = myPort.read(); // Modtager sample nr
  println("SampleNr:\t", hex(tempStorage));
  if(tempStorage != sampleNr){
    println("Error slut");
    myPort.write(ERROR_MSG);
    return false;
  } else {
    println("Lykkedes");
    myPort.write(OK_MSG);
  }
  println("Other Stuff");
  // myPort.write(OK_MSG);
  return true;
}
*/

void waitForSerial(){
  int timeStart = millis();
  while(myPort.available() == 0){
    if((millis() > timeStart + TIMEOUT)){
      // Vi er nu gået i timeout
      spamOK();
      return;
    }
  }
}

void spamOK(){
  for(int i = 0; i < 10; i++){
    myPort.write(OK_MSG);
  }
}